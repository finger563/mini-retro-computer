## main/Kconfig.projbuild
```kconfig
menu "Mini Retro Computer Configuration"

choice MRP_HARDWARE
  prompt "Hardware"
  help
    This option allows you to select the type of hardware you are using for your Mini Retro Computer.
    Choose the appropriate option based on your hardware setup.

config MRP_HARDWARE_BYTE90
  bool "Byte90"
  help
    Select this option if you are using the Byte 90 hardware.

config MRP_HARDWARE_WS_S3_TOUCHLCD
  bool "Waveshare ESP32-S3 TouchLCD"
  help
    Select this option if you are using the Waveshare ESP32-S3 TouchLCD hardware.

endchoice

endmenu
```

## sdkconfig.defaults
```kconfig
CONFIG_IDF_TARGET="esp32s3"

CONFIG_FREERTOS_HZ=1000

CONFIG_COMPILER_OPTIMIZATION_PERF=y

# ESP32-specific
#
CONFIG_ESP_DEFAULT_CPU_FREQ_MHZ_240=y
CONFIG_ESP_DEFAULT_CPU_FREQ_MHZ=240

# Common ESP-related
#
CONFIG_ESP_SYSTEM_EVENT_TASK_STACK_SIZE=4096
CONFIG_ESP_MAIN_TASK_STACK_SIZE=8192
CONFIG_ESP_TIMER_TASK_STACK_SIZE=8192

#
# Flash size
#
CONFIG_ESPTOOLPY_FLASHSIZE_4MB=y

#
# Partition Table
#
CONFIG_PARTITION_TABLE_CUSTOM=y
CONFIG_PARTITION_TABLE_CUSTOM_FILENAME="partitions.csv"

#
# LVGL configuration - # Monitoring
#
CONFIG_LV_USE_PERF_MONITOR=n
CONFIG_LV_USE_MEM_MONITOR=n

#
# LVGL configuration - # Themes
#
CONFIG_LV_USE_THEME_DEFAULT=y
CONFIG_LV_THEME_DEFAULT_DARK=y
CONFIG_LV_THEME_DEFAULT_GROW=y
CONFIG_LV_THEME_DEFAULT_TRANSITION_TIME=30
CONFIG_LV_MEM_SIZE_KILOBYTES=64

# font configuration
CONFIG_LV_FONT_UNSCII_8=y
CONFIG_LV_FONT_DEFAULT_UNSCII_8=y

# disable the task watchdog
CONFIG_ESP_TASK_WDT_EN=n
```
